## boards/shields/nltemper/Kconfig.shield
```kconfig
config SHIELD_NLTEMPER_LEFT
    def_bool $(shields_list_contains,nltemper_left)

config SHIELD_NLTEMPER_RIGHT
    def_bool $(shields_list_contains,nltemper_right)
```
